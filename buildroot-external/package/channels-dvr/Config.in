## buildroot-external/package/channels-dvr/Config.in
```kconfig
menuconfig BR2_PACKAGE_CHANNELS_DVR
	bool "Channels DVR server"
	help
	  This is the Application layer containing the DVR
```

## buildroot-external/package/wsdd2/Config.in
```kconfig
config BR2_PACKAGE_WSDD2
	bool "wsdd2"
	help
	  WSD/LLMNR Discovery/Name Service Daemon

	  https://github.com/Andy2244/wsdd2
```
